## containers/nut/buildroot-external/configs/nut_routeros_armv5_defconfig
```kconfig
BR2_arm=y
BR2_arm926t=y
BR2_TOOLCHAIN_BUILDROOT_MUSL=y
BR2_TOOLCHAIN_BUILDROOT_CXX=y
BR2_INIT_NONE=y
BR2_PACKAGE_BUSYBOX=y
BR2_SYSTEM_BIN_SH_BUSYBOX=y
BR2_PACKAGE_LIBUSB=y
BR2_PACKAGE_NUT=y
BR2_PACKAGE_NUT_DRIVERS="usbhid-ups"
BR2_ROOTFS_OVERLAY="$(BR2_EXTERNAL_MIKROTIK_NUT_PATH)/board/nut/rootfs-overlay"
BR2_ROOTFS_POST_FAKEROOT_SCRIPT="$(BR2_EXTERNAL_MIKROTIK_NUT_PATH)/board/nut/post-fakeroot.sh"
BR2_TARGET_ROOTFS_TAR=y
BR2_REPRODUCIBLE=y
```
